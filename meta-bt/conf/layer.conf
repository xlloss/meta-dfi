## meta-bt/conf/layer.conf
```bitbake
# We have a conf and classes directory, add to BBPATH
BBPATH .= ":${LAYERDIR}"

# We have recipes-* directories, add to BBFILES
BBFILES += " ${LAYERDIR}/recipes-*/*/*.bb ${LAYERDIR}/recipes-*/*/*.bbappend"

BBFILE_COLLECTIONS += "bt"
BBFILE_PATTERN_bt = "^${LAYERDIR}/"
BBFILE_PRIORITY_bt = "50"
LAYERVERSION_bt = "2"
LAYERSERIES_COMPAT_bt = "sumo thud warrior zeus"
```

## meta-hdmi-udev/conf/layer.conf
```bitbake
# We have a conf and classes directory, add to BBPATH
BBPATH .= ":${LAYERDIR}"

# We have recipes-* directories, add to BBFILES
BBFILES += " ${LAYERDIR}/recipes-*/*/*.bb ${LAYERDIR}/recipes-*/*/*.bbappend"

BBFILE_COLLECTIONS += "hdmi-udev"
BBFILE_PATTERN_hdmi-udev = "^${LAYERDIR}/"
BBFILE_PRIORITY_hdmi-udev = "50"
LAYERVERSION_hdmi-udev = "2"
LAYERSERIES_COMPAT_hdmi-udev = "sumo thud warrior zeus"
```

## meta-image/conf/layer.conf
```bitbake
# We have a conf and classes directory, add to BBPATH
BBPATH .= ":${LAYERDIR}"

# We have recipes-* directories, add to BBFILES
BBFILES += " ${LAYERDIR}/recipes-*/*/*.bb ${LAYERDIR}/recipes-*/*/*.bbappend"

BBFILE_COLLECTIONS += "image"
BBFILE_PATTERN_image = "^${LAYERDIR}/"
BBFILE_PRIORITY_image = "50"
LAYERVERSION_image = "2"
LAYERSERIES_COMPAT_image = "sumo thud warrior zeus"
```

## meta-overwrite/conf/layer.conf
```bitbake
# We have a conf and classes directory, add to BBPATH
BBPATH .= ":${LAYERDIR}"

# We have recipes-* directories, add to BBFILES
BBFILES += " ${LAYERDIR}/recipes-*/*/*.bb ${LAYERDIR}/recipes-*/*/*.bbappend"

BBFILE_COLLECTIONS += "overwrite"
BBFILE_PATTERN_overwrite = "^${LAYERDIR}/"
BBFILE_PRIORITY_overwrite = "50"
LAYERVERSION_overwrite = "2"
LAYERSERIES_COMPAT_overwrite = "sumo thud warrior zeus"
```

## meta-rs485/conf/layer.conf
```bitbake
# We have a conf and classes directory, add to BBPATH
BBPATH .= ":${LAYERDIR}"

# We have recipes-* directories, add to BBFILES
BBFILES += " ${LAYERDIR}/recipes-*/*/*.bb ${LAYERDIR}/recipes-*/*/*.bbappend"

BBFILE_COLLECTIONS += "rs485"
BBFILE_PATTERN_rs485 = "^${LAYERDIR}/"
BBFILE_PRIORITY_rs485 = "50"
LAYERVERSION_rs485 = "2"
LAYERSERIES_COMPAT_rs485 = "sumo thud warrior zeus"
```

## meta-wifi/conf/layer.conf
```bitbake
# We have a conf and classes directory, add to BBPATH
BBPATH .= ":${LAYERDIR}"

# We have recipes-* directories, add to BBFILES
BBFILES += " ${LAYERDIR}/recipes-*/*/*.bb ${LAYERDIR}/recipes-*/*/*.bbappend"

BBFILE_COLLECTIONS += "wifi"
BBFILE_PATTERN_wifi = "^${LAYERDIR}/"
BBFILE_PRIORITY_wifi = "50"
LAYERVERSION_wifi = "2"
LAYERSERIES_COMPAT_wifi = "sumo thud warrior zeus"
```
